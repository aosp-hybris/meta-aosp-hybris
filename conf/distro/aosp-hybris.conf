## conf/distro/aosp-hybris.conf
```bitbake
#
# Copyright (C) 2014 Yen-Chin, Lee <coldnew.tw@gmail.com>
#
# This program is free software; you can redistribute it and/or modify
# it under the terms of the GNU General Public License version 2 as
# published by the Free Software Foundation.
#
# This program is distributed in the hope that it will be useful,
# but WITHOUT ANY WARRANTY; without even the implied warranty of
# MERCHANTABILITY or FITNESS FOR A PARTICULAR PURPOSE.  See the
# GNU General Public License for more details.
#
# You should have received a copy of the GNU General Public License along
# with this program; if not, write to the Free Software Foundation, Inc.,
# 51 Franklin Street, Fifth Floor, Boston, MA 02110-1301 USA.

MAINTAINER = "Yen-Chin Lee <coldnew.tw@gmail.com>"

# Distro setup
DISTRO = "aosp-hybris"
DISTRO_NAME = "AOSP Hybris"
DISTRO_VERSION ?= "${DATE}-snapshot"

# FIXME: what should we do with this?
TCLIBCAPPEND = ""

# Disable wide char support for ncurses as we don't include it in
# in the LIBC features below.
# Leave native enable to avoid build failures
ENABLE_WIDEC = "false"
ENABLE_WIDEC_class-native = "true"

# Drop native language support. This removes the
# eglibc->bash->gettext->libc-posix-clang-wchar dependency.
USE_NLS="no"

# Set our distro features, don't forget all the standard libc ones
DISTRO_FEATURES = "wayland opengl alsa ipv4 ${DISTRO_FEATURES_LIBC}"

# The mtrace script included by eglibc is a perl script. This means the system
# will build perl in case this package is installed. Since we don't care about
# this script for the purposes of tiny, remove the dependency from here.
RDEPENDS_${PN}-mtrace_pn-eglibc = ""

# Enable UI and scripting for perf
PERF_FEATURES_ENABLE ?= "perf-scripting perf-tui"

# Disable polkit's systemd configuration from meta-oe
POLKITAUTH = ""

# Use systemd as our runtime services
VIRTUAL-RUNTIME_init_manager = "systemd"
VIRTUAL-RUNTIME_initscripts = ""
DISTRO_FEATURES_append = " systemd "
DISTRO_FEATURES_BACKFILL_CONSIDERED = "sysvinit"

# This tells libc packaging that no locales are to be packaged
PACKAGE_NO_GCONV = "1"

# Load default preferences
require conf/distro/include/hybris-blacklist.inc
require conf/distro/include/hybris-sdk.inc
```

## conf/layer.conf
```bitbake
# We have a conf and classes directory, add to BBPATH
BBPATH .= ":${LAYERDIR}"

# We have recipes-* directories, add to BBFILES
BBFILES += "${LAYERDIR}/recipes-*/*/*.bb \
        ${LAYERDIR}/recipes-*/*/*.bbappend"

BBFILE_COLLECTIONS += "aosp-hybris"
BBFILE_PATTERN_aosp-hybris = "^${LAYERDIR}/"
BBFILE_PRIORITY_aosp-hybris = "6"

UBUNTU_MIRROR ?= "https://launchpad.net/ubuntu/+archive/primary/+files"

AOSP_HYBRIS_MIRROR ?= "http://aosp-hybris.github.io/prebuilt"
```

## conf/machine/emulator.conf
```bitbake
#@TYPE: Machine
#@NAME: Android Machine setup
#@DESCRIPTION: Machine configuration for the Android platform

DEFAULTTUNE ?= "armv7ahf-neon"

require conf/machine/include/arm/arch-armv7a.inc

KERNEL_IMAGETYPE = "zImage"

IMAGE_FSTYPES = "tar.bz2 ext4"
EXTRA_IMAGECMD_yaffs2 = "0"

SERIAL_CONSOLE = "115200 ttyS0"

PREFERRED_PROVIDER_virtual/kernel = "linux-goldfish"
```

## conf/machine/goldfisharmv7.conf
```bitbake
#@TYPE: Machine
#@NAME: Android Machine setup
#@DESCRIPTION: Machine configuration for the Android platform

DEFAULTTUNE ?= "armv7ahf-neon"

require conf/machine/include/arm/arch-armv7a.inc

KERNEL_IMAGETYPE = "zImage"

IMAGE_FSTYPES = "tar.bz2 ext4"

SERIAL_CONSOLE = "115200 ttyS0"

PREFERRED_PROVIDER_virtual/kernel = "linux-goldfish"


# Select for Hybris version for different kernel version
# hybris-4.2.2_r1   => 2.6.29
# hybris-4.4.2_r1   => 3.4
ANDROID_VERSION ?= "hybris-4.2.2_r1"
# ANDROID_VERSION ?= "hybris-4.4.2_r1"

PREFERRED_VERSION_virtual/kernel = "2.6.29+git%"
#PREFERRED_VERSION_android-system = "4.2.2+git%"
```
